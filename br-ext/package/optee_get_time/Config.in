## br-ext/package/optee_get_time/Config.in
```kconfig
config BR2_PACKAGE_OPTEE_GET_TIME
	bool "optee_get_time"
	help
	  optee_get_time project

if BR2_PACKAGE_OPTEE_GET_TIME

config BR2_PACKAGE_OPTEE_GET_TIME_SITE
	string "OP-TEE get_time path"
	default ""
	help
	  The path to the source directory of OP-TEE get_time

config BR2_PACKAGE_OPTEE_GET_TIME_SDK
	string "OPTEE SDK path"
	default ""
	help
	  some help

config BR2_PACKAGE_OPTEE_GET_TIME_CROSS_COMPILE
	string "OPTEE cross compiler"
	default ""
	help
	  some help

endif
```
